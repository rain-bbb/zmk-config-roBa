## config/west.yml
```yaml
manifest:
  remotes:
    - name: zmkfirmware
      url-base: https://github.com/zmkfirmware
    - name: rain-bbb
      url-base: https://github.com/rain-bbb
  projects:
    - name: zmk
      remote: zmkfirmware
      revision: main
      import: app/west.yml
    - name: zmk-pmw3610-driver
      remote: rain-bbb
      revision: main
    - name: prospector-zmk-module
      remote: prospector
      revision: v1.1.1
      path: modules/prospector-zmk-module
  self:
    path: config
```
